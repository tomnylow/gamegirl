#ifndef BRICK_BREAKER_H
#define BRICK_BREAKER_H

#include <Adafruit_SSD1306.h>

#define SCREEN_WIDTH 128
#define SCREEN_HEIGHT 64

#define BALL_RADIUS 5
#define PADDLE_WIDTH 40
#define PADDLE_HEIGHT 5
#define BRICK_WIDTH 20
#define BRICK_HEIGHT 10
#define BRICK_ROWS 3
#define BRICK_COLS 6
#define BUTTON_LEFT_PIN 7
#define BUTTON_RIGHT_PIN 10
#define SPEAKER_PIN 9

class Arcanoid {
public:
    static const uint8_t  PROGMEM arc_img[1024];

    Arcanoid(Adafruit_SSD1306* display) : display(display) {}
    
    void setup() {
        pinMode(SPEAKER_PIN, OUTPUT);
        if(!display->begin(SSD1306_SWITCHCAPVCC, 0x3C)) {
            Serial.println("SSD1306 allocation failed");
            while(1);
        }
        randomSeed(analogRead(A0));
        pinMode(BUTTON_LEFT_PIN, INPUT_PULLUP);
        pinMode(BUTTON_RIGHT_PIN, INPUT_PULLUP);
        resetGame();
        display->drawBitmap(0, 0, arc_img, 128, 64, 1);
        display->display();
        delay(3000);
    }

    void loop() {
        updateBall();
        checkCollisions();
        movePaddle();
        checkBricks();
        drawGame();
        delay(10);
    }

    void resetGame() {
        ballX = SCREEN_WIDTH / 2;
        ballY = SCREEN_HEIGHT - PADDLE_HEIGHT - BALL_RADIUS;
        int randomDirection = random(0, 2) ? -1 : 1;
        ballSpeedX = (random(1, 3) * randomDirection);
        ballSpeedY = -(random(1, 3) );
        for (int i = 0; i < BRICK_ROWS; i++) {
            for (int j = 0; j < BRICK_COLS; j++) {
                bricks[i][j] = true;
            }
        }
        gameWon = false;
    }
    
private:
    Adafruit_SSD1306* display;
    int ballX = SCREEN_WIDTH / 2;
    int ballY = SCREEN_HEIGHT - 10;
    int ballSpeedX = 2;
    int ballSpeedY = 2;
    int paddleX = SCREEN_WIDTH / 2 - 20;
    int paddleY = SCREEN_HEIGHT - PADDLE_HEIGHT;
    bool bricks[BRICK_ROWS][BRICK_COLS] = {false};
    bool gameWon = false;

    void updateBall() {
        ballX += ballSpeedX;
        ballY += ballSpeedY;
    }

    void checkCollisions() {
        if (ballX - BALL_RADIUS < 0 || ballX + BALL_RADIUS > SCREEN_WIDTH) {
            ballSpeedX = -ballSpeedX;
            tone(SPEAKER_PIN, 2000, 200);
        }
        if (ballY - BALL_RADIUS < 0) {
            ballSpeedY = -ballSpeedY;
            tone(SPEAKER_PIN, 2000, 200);
        }
        if (ballY + BALL_RADIUS > SCREEN_HEIGHT) {
            displayFailMessage();
            resetGame();
            paddleX = SCREEN_WIDTH / 2 - 20;
        }
        // Проверка столкновения с платформой
        if (ballY + BALL_RADIUS >= paddleY && ballY + BALL_RADIUS <= paddleY + PADDLE_HEIGHT && ballX >= paddleX && ballX <= paddleX + PADDLE_WIDTH) {
          ballSpeedY = -ballSpeedY;
        }
    }

    void movePaddle() {        if (digitalRead(BUTTON_LEFT_PIN) == LOW) {
            paddleX = max(0, paddleX - 5);
        }
        if (digitalRead(BUTTON_RIGHT_PIN) == LOW) {
            paddleX = min(SCREEN_WIDTH - PADDLE_WIDTH, paddleX + 5);
        }
    }

    void checkBricks() {
        bool allBricksDestroyed = true;
        for (int i = 0; i < BRICK_ROWS; i++) {
            for (int j = 0; j < BRICK_COLS; j++) {
                if (bricks[i][j] && ballX >= j * BRICK_WIDTH && ballX <= (j + 1) * BRICK_WIDTH && ballY >= i * BRICK_HEIGHT && ballY <= (i + 1) * BRICK_HEIGHT) {
                    bricks[i][j] = false;
                    ballSpeedY = -ballSpeedY;
                    tone(SPEAKER_PIN, 2000, 200);
                }
                if (bricks[i][j]) {
                    allBricksDestroyed = false;
                }
            }
        }
        if (allBricksDestroyed) {
            gameWon = true;
        }
    }

    void drawGame() {
        display->clearDisplay();
        display->fillCircle(ballX, ballY, BALL_RADIUS, SSD1306_WHITE);
        display->fillRect(paddleX, paddleY, PADDLE_WIDTH, PADDLE_HEIGHT, SSD1306_WHITE);
        for (int i = 0; i < BRICK_ROWS; i++) {
            for (int j = 0; j < BRICK_COLS; j++) {
                if (bricks[i][j]) {
                    display->fillRect(j * BRICK_WIDTH, i * BRICK_HEIGHT, BRICK_WIDTH, BRICK_HEIGHT, SSD1306_WHITE);
                }
            }
        }
        if (gameWon) {
            display->setTextSize(3);
            display->setTextColor(SSD1306_WHITE);
            display->setCursor(SCREEN_WIDTH / 2, SCREEN_HEIGHT / 2);
            display->println("WIN");
        }
        display->display();
    }

    void displayFailMessage() {
        display->setTextSize(2);
        display->setTextColor(SSD1306_WHITE);
        display->setCursor(SCREEN_WIDTH / 2 - 30, SCREEN_HEIGHT / 2);
        display->println("FAIL");
        display->display();
        tone(SPEAKER_PIN, 1000, 400);
        delay(1000);
    }

    
};

const uint8_t PROGMEM Arcanoid::arc_img[1024] = {
0xff, 0xff, 0xff, 0xff, 0xff, 0xff, 0xff, 0xf7, 0xf7, 0xff, 0xff, 0xff, 0xff, 0xff, 0xff, 0xff, 
    0xff, 0xff, 0xff, 0xff, 0xff, 0xff, 0xff, 0xff, 0xff, 0xff, 0xff, 0xff, 0xff, 0xff, 0xff, 0xff, 
    0xff, 0xff, 0xff, 0xff, 0xff, 0xff, 0xff, 0xff, 0xff, 0xff, 0xff, 0xff, 0xff, 0xff, 0xff, 0xff, 
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    0xff, 0xff, 0xff, 0xff, 0xff, 0xe3, 0xff, 0xff, 0xff, 0x3f, 0xff, 0xff, 0xff, 0xff, 0x3f, 0xff
};
#endif // BRICK_BREAKER_H
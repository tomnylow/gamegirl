#include <Wire.h>
#include <Adafruit_SSD1306.h>
#include <Adafruit_GFX.h>


int speakerPin = 9; 

// Размеры экрана
#define SCREEN_WIDTH 128
#define SCREEN_HEIGHT 64

// Инициализация дисплея
Adafruit_SSD1306 display(SCREEN_WIDTH, SCREEN_HEIGHT, &Wire, -1);

// Игровые переменные
int ballX = SCREEN_WIDTH / 2;
int ballY = SCREEN_HEIGHT - 10;
int ballRadius = 5;

int paddleWidth = 40;
int paddleHeight = 5;
int paddleX = SCREEN_WIDTH / 2 - 20;
int paddleY = SCREEN_HEIGHT - paddleHeight;

int brickWidth = 20;
int brickHeight = 10;
const int brickRows = 2;
const int brickCols = 6;
bool bricks[brickRows][brickCols] = {false};
int ballSpeedX = 2;
int ballSpeedY = 2;
const int buttonLeftPin = 7;
const int buttonRightPin = 10;
bool gameWon = false;

static const uint8_t  PROGMEM arc_img[1024] = {
0xff, 0xff, 0xff, 0xff, 0xff, 0xff, 0xff, 0xf7, 0xf7, 0xff, 0xff, 0xff, 0xff, 0xff, 0xff, 0xff, 
    0xff, 0xff, 0xff, 0xff, 0xff, 0xff, 0xff, 0xff, 0xff, 0xff, 0xff, 0xff, 0xff, 0xff, 0xff, 0xff, 
    0xff, 0xff, 0xff, 0xff, 0xff, 0xff, 0xff, 0xff, 0xff, 0xff, 0xff, 0xff, 0xff, 0xff, 0xff, 0xff, 
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    0xff, 0xff, 0xff, 0xff, 0xff, 0xe3, 0xff, 0xff, 0xff, 0x3f, 0xff, 0xff, 0xff, 0xff, 0x3f, 0xff
};

void setup() {
  pinMode(speakerPin, OUTPUT);
  // Инициализация дисплея
  if(!display.begin(SSD1306_SWITCHCAPVCC, 0x3C)) {
    Serial.println("SSD1306 allocation failed");
    while(1);
  }
  randomSeed(analogRead(A0));
  pinMode(buttonLeftPin, INPUT_PULLUP);
  pinMode(buttonRightPin, INPUT_PULLUP);
  resetGame();
  display.drawBitmap(0, 0, arc_img, 128, 64, 1);
  display.display();
  delay(3000);
}

void loop() {
  // Обновление позиции мяча
  ballX += ballSpeedX;
  ballY += ballSpeedY;

  // Проверка столкновений с краями
  if (ballX - ballRadius < 0 || ballX + ballRadius > SCREEN_WIDTH) {
    ballSpeedX = -ballSpeedX;
    tone(speakerPin, 2000, 200);
  }
  if (ballY - ballRadius < 0) {
    ballSpeedY = -ballSpeedY;
    tone(speakerPin, 2000, 200);
  }
  if (ballY + ballRadius > SCREEN_HEIGHT) {
    display.setTextSize(2);
    display.setTextColor(SSD1306_WHITE);
    display.setCursor(SCREEN_WIDTH / 2 - 30, SCREEN_HEIGHT / 2);
    display.println("FAIL");
    display.display();
    tone(speakerPin, 1000, 400);
    delay(1000);
    resetGame();
    paddleX = SCREEN_WIDTH / 2 - 20;
  }

  // Проверка нажатия кнопок и перемещение платформы
  if (digitalRead(buttonLeftPin) == LOW) {
    paddleX = max(0, paddleX - 5);
  }
  if (digitalRead(buttonRightPin) == LOW) {
    paddleX = min(SCREEN_WIDTH - paddleWidth, paddleX + 5);
  }

  // Проверка столкновения с платформой
  if (ballY + ballRadius >= paddleY && ballY + ballRadius <= paddleY + paddleHeight && ballX >= paddleX && ballX <= paddleX + paddleWidth) {
    ballSpeedY = -ballSpeedY;
  }

  // Проверка уничтожения блоков
  bool allBricksDestroyed = true;
  for (int i = 0; i < brickRows; i++) {
    for (int j = 0; j < brickCols; j++) {
      if (bricks[i][j] && ballX >= j * brickWidth && ballX <= (j + 1) * brickWidth && ballY >= i * brickHeight && ballY <= (i + 1) * brickHeight) {
        bricks[i][j] = false;
        ballSpeedY = -ballSpeedY;
        tone(speakerPin, 2000, 200);
      }
      if (bricks[i][j]) {
        allBricksDestroyed = false;
      }
    }
  }

  if (allBricksDestroyed) {
    gameWon = true;
  }

  // Отрисовка игрового поля
  drawGame();

  // Задержка для плавности анимации
  delay(10);
}

void drawGame() {
  // Очистка экрана
  display.clearDisplay();

  // Отрисовка мяча
  display.fillCircle(ballX, ballY, ballRadius, SSD1306_WHITE);

  // Отрисовка платформы
  display.fillRect(paddleX, paddleY, paddleWidth, paddleHeight, SSD1306_WHITE);

  // Отрисовка блоков
  for (int i = 0; i < brickRows; i++) {
    for (int j = 0; j < brickCols; j++) {
      if (bricks[i][j]) {
        display.fillRect(j * brickWidth, i * brickHeight, brickWidth, brickHeight, SSD1306_WHITE);
      }
    }
  }

  // Отображение "WIN" при победе
  if (gameWon) {
    display.setTextSize(3);
    display.setTextColor(SSD1306_WHITE);
    display.setCursor(SCREEN_WIDTH / 2, SCREEN_HEIGHT / 2);
    display.println("WIN");
  }

  // Обновление экрана
  display.display();
}

void resetGame() {
  // Сброс позиции мяча
  ballX = SCREEN_WIDTH / 2;
  ballY = SCREEN_HEIGHT - paddleHeight - ballRadius;
  int randomDirection = random(0, 2) ? -1 : 1;
  ballSpeedX = (random(1, 3) * randomDirection);
  ballSpeedY = (random(1, 3) );

  // Сброс состояния блоков
  for (int i = 0; i < brickRows; i++) {
    for (int j = 0; j < brickCols; j++) {
      bricks[i][j] = true;
    }
  }

  // Сброс состояния игры
  gameWon = false;

  // Отрисовка обновленного экрана
  drawGame();
}